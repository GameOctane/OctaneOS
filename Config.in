## Config.in
```kconfig
mainmenu "OctaneOS Configuration"

source "$BR2_EXTERNAL_OCTANEOS_PATH/package/pvrsrvkm/Config.in"
```

## package/pvrsrvkm/Config.in
```kconfig
config BR2_PACKAGE_PVRSRVKM
	bool "pvrsrvkm"
	depends on BR2_aarch64
	depends on BR2_LINUX_KERNEL
	help
	  Imagination PowerVR BXM-4-64 MC1 kernel module for Allwinner A733.
	  Provides hardware OpenGL ES 3.2, Vulkan 1.3, and OpenCL 3.0.
	  Built from the allwinner-bsp gpu/img-bxm source tree.
```
